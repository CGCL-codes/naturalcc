## code_agent/artifacts/contract3/engineering-v6/context-recipes/atomic-c/Kconfig
```kconfig
mainmenu "Contract-3 native atomic C analysis configuration"
source "Kconfig.zephyr"
config CONTRACT3_ATOMIC_C
    bool "Select the pure C atomic implementation for analysis"
    select ATOMIC_OPERATIONS_C
```
